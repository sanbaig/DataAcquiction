## CMakeLists.txt
```
# 指定 CMake 最低版本
cmake_minimum_required(VERSION 3.20.0)

# 查找并加载 Zephyr SDK 构建环境
find_package(Zephyr REQUIRED HINTS $ENV{ZEPHYR_BASE})

# 定义当前工程名称
project(StretchSense_BLE_Test)

# 将 main.c 添加到当前应用程序的编译列表
target_sources(app PRIVATE src/main.c)
```

## prj.conf
```kconfig
# ============================
# Bluetooth 蓝牙基本配置
# ============================

# 启用 Bluetooth 协议栈
CONFIG_BT=y

# 启用 BLE Peripheral（外围设备）角色
# 本设备作为传感器端，等待电脑主动连接
CONFIG_BT_PERIPHERAL=y

# 设置 BLE 广播时显示的设备名称
CONFIG_BT_DEVICE_NAME="StretchSense"

# 最大允许连接数设置为 1
# 当前测试只需要一台电脑连接设备
CONFIG_BT_MAX_CONN=1


# ============================
# 日志与调试配置
# ============================

# 启用 printk()，允许通过串口输出调试信息
CONFIG_PRINTK=y

# 启用 Zephyr 日志系统
CONFIG_LOG=y


# ============================
# 系统内存配置
# ============================

# 设置主线程堆栈大小为 2048 字节
CONFIG_MAIN_STACK_SIZE=2048

# 设置系统工作队列线程堆栈大小为 2048 字节
CONFIG_SYSTEM_WORKQUEUE_STACK_SIZE=2048

# GPIO outputs drive the two sensor excitation lines.
CONFIG_GPIO=y

# Enable the nRF52832 SAADC.
CONFIG_ADC=y
CONFIG_ADC_NRFX_SAADC=y
```

## src/main.c
```c
/************************************************************
 * Project : StretchSense_BLE_Test
 * MCU     : Nordic nRF52832
 * SDK     : nRF Connect SDK v3.3.5
 *
 * Function:
 * 1. Initialize Bluetooth Low Energy (BLE)
 * 2. Advertise the device as a BLE Peripheral
 * 3. Create a custom GATT Service
 * 4. Generate two channels of simulated sensor data
 * 5. Transmit data through BLE Notifications
 * 6. Automatically restart advertising after disconnection
 *
 * Data transmission:
 * CH1: uint16_t
 * CH2: uint16_t
 * Sampling interval: 100 ms
 * Transmission rate: 10 packets/s
 ************************************************************/

#include <errno.h>

#include <zephyr/kernel.h>
#include <zephyr/device.h>
#include <zephyr/drivers/adc.h>
#include <zephyr/drivers/gpio.h>
#include <zephyr/sys/byteorder.h>
#include <zephyr/sys/printk.h>
#include <zephyr/sys/util.h>

#include <zephyr/bluetooth/bluetooth.h>
#include <zephyr/bluetooth/conn.h>
#include <zephyr/bluetooth/gatt.h>
#include <zephyr/bluetooth/uuid.h>

#include <hal/nrf_saadc.h>

#define DEVICE_NAME "StretchSense"

/* 原理图：ADC_CH1=P0.02/AIN0，ADC_CH2=P0.03/AIN1 */
/*不知道为什么这个芯片上物理引脚上电压都能对的上，但是发出去和接收的CH1和CH2是反的，所以变成了CH1是0，CH2是1
而且，这个CH1本来在物理引脚13上的，但是一直收不到数据，而且会受到CH2的变化而变化。
所以这个时候找到了一个解决方法，将物理引脚13和物理引脚15短接，这样就能稳定收到了，不知道为什么。
*/
#define ADC_CHANNEL_CH1 0
#define ADC_CHANNEL_CH2 1
#define ADC_PIN_CH1 NRF_SAADC_INPUT_AIN1 
#define ADC_PIN_CH2 NRF_SAADC_INPUT_AIN0

/* 原理图：EXC_CH1=P0.13，EXC_CH2=P0.14 */
#define EXC_CH1_PIN 13
#define EXC_CH2_PIN 14

#define ADC_RESOLUTION 12
#define ADC_ACQUISITION_TIME \
    ADC_ACQ_TIME(ADC_ACQ_TIME_MICROSECONDS, 40)

#define BT_UUID_SENSOR_SERVICE_VAL \
    BT_UUID_128_ENCODE(0x12345678, 0x1234, 0x5678, \
                       0x1234, 0x56789abcdef0)

#define BT_UUID_SENSOR_DATA_VAL \
    BT_UUID_128_ENCODE(0x12345679, 0x1234, 0x5678, \
                       0x1234, 0x56789abcdef0)

#define BT_UUID_SENSOR_SERVICE \
    BT_UUID_DECLARE_128(BT_UUID_SENSOR_SERVICE_VAL)

#define BT_UUID_SENSOR_DATA \
    BT_UUID_DECLARE_128(BT_UUID_SENSOR_DATA_VAL)

static bool send_enabled;
static bool ble_connected;

static const struct device *adc_dev =
    DEVICE_DT_GET(DT_NODELABEL(adc));
static const struct device *gpio0_dev =
    DEVICE_DT_GET(DT_NODELABEL(gpio0));

static uint16_t ch1;
static uint16_t ch2;

/* 初始化 EXC 输出和两个 SAADC 输入通道 */
static int sensor_io_init(void)
{
    if (!device_is_ready(adc_dev)) {
        printk("SAADC device is not ready.\n");
        return -ENODEV;
    }

    if (!device_is_ready(gpio0_dev)) {
        printk("GPIO0 device is not ready.\n");
        return -ENODEV;
    }

    int err = gpio_pin_configure(
        gpio0_dev, EXC_CH1_PIN, GPIO_OUTPUT_ACTIVE);
    if (err) {
        printk("Failed to configure EXC_CH1: %d\n", err);
        return err;
    }

    err = gpio_pin_configure(
        gpio0_dev, EXC_CH2_PIN, GPIO_OUTPUT_ACTIVE);
    if (err) {
        printk("Failed to configure EXC_CH2: %d\n", err);
        return err;
    }

    const struct adc_channel_cfg ch1_cfg = {
        .gain = ADC_GAIN_1_4,
        .reference = ADC_REF_VDD_1_4,
        .acquisition_time = ADC_ACQUISITION_TIME,
        .channel_id = ADC_CHANNEL_CH1,
        .input_positive = ADC_PIN_CH1,
    };

    const struct adc_channel_cfg ch2_cfg = {
        .gain = ADC_GAIN_1_4,
        .reference = ADC_REF_VDD_1_4,
        .acquisition_time = ADC_ACQUISITION_TIME,
        .channel_id = ADC_CHANNEL_CH2,
        .input_positive = ADC_PIN_CH2,
    };

    err = adc_channel_setup(adc_dev, &ch1_cfg);
    if (err) {
        printk("Failed to configure ADC_CH1: %d\n", err);
        return err;
    }

    err = adc_channel_setup(adc_dev, &ch2_cfg);
    if (err) {
        printk("Failed to configure ADC_CH2: %d\n", err);
        return err;
    }

    printk("Sensor I/O ready: CH1=P0.02/AIN0, CH2=P0.03/AIN1, "
           "EXC1=P0.13, EXC2=P0.14.\n");

    return 0;
}

/* 在同一个 ADC sequence 中读取两路输入，缓冲区顺序与 channel_id 一致 */
static int sensor_read(uint16_t *ch1_value, uint16_t *ch2_value)
{
    int16_t samples[2] = {0};

    const struct adc_sequence sequence = {
        .channels = BIT(ADC_CHANNEL_CH1) | BIT(ADC_CHANNEL_CH2),
        .buffer = samples,
        .buffer_size = sizeof(samples),
        .resolution = ADC_RESOLUTION,
    };

    int err = adc_read(adc_dev, &sequence);
    if (err) {
        return err;
    }

    *ch1_value = (uint16_t)MAX(samples[0], 0);
    *ch2_value = (uint16_t)MAX(samples[1], 0);

    return 0;
}

static const struct bt_data advertising_data[] = {
    BT_DATA_BYTES(
        BT_DATA_FLAGS,
        BT_LE_AD_GENERAL | BT_LE_AD_NO_BREDR
    ),
    BT_DATA(
        BT_DATA_NAME_COMPLETE,
        DEVICE_NAME,
        sizeof(DEVICE_NAME) - 1
    ),
};

static void advertising_start_handler(struct k_work *work);

K_WORK_DELAYABLE_DEFINE(
    advertising_start_work,
    advertising_start_handler
);

static void advertising_start_handler(struct k_work *work)
{
    ARG_UNUSED(work);

    if (ble_connected) {
        return;
    }

    int err = bt_le_adv_start(
        BT_LE_ADV_CONN_FAST_1,
        advertising_data,
        ARRAY_SIZE(advertising_data),
        NULL,
        0
    );

    if (err == 0) {
        printk("Advertising started successfully.\n");
    } else {
        printk("Advertising start failed: %d. Retrying...\n", err);
        k_work_schedule(
            &advertising_start_work,
            K_SECONDS(1)
        );
    }
}

static void ccc_changed(
    const struct bt_gatt_attr *attr,
    uint16_t value
)
{
    ARG_UNUSED(attr);

    send_enabled = (value == BT_GATT_CCC_NOTIFY);
    printk("Notification %s.\n",
           send_enabled ? "enabled" : "disabled");
}

BT_GATT_SERVICE_DEFINE(
    sensor_service,

    BT_GATT_PRIMARY_SERVICE(BT_UUID_SENSOR_SERVICE),

    BT_GATT_CHARACTERISTIC(
        BT_UUID_SENSOR_DATA,
        BT_GATT_CHRC_NOTIFY,
        BT_GATT_PERM_NONE,
        NULL,
        NULL,
        NULL
    ),

    BT_GATT_CCC(
        ccc_changed,
        BT_GATT_PERM_READ | BT_GATT_PERM_WRITE
    )
);

static void connected(struct bt_conn *conn, uint8_t err)
{
    ARG_UNUSED(conn);

    if (err) {
        printk("Connection failed: %u\n", err);
        return;
    }

    ble_connected = true;
    send_enabled = false;

    k_work_cancel_delayable(&advertising_start_work);
    printk("BLE connected.\n");
}

static void disconnected(
    struct bt_conn *conn,
    uint8_t reason
)
{
    ARG_UNUSED(conn);

    ble_connected = false;
    send_enabled = false;

    printk("BLE disconnected: %u\n", reason);

    k_work_schedule(
        &advertising_start_work,
        K_MSEC(500)
    );
}

BT_CONN_CB_DEFINE(conn_callbacks) = {
    .connected = connected,
    .disconnected = disconnected,
};

static void sensor_work_handler(struct k_work *work);

K_WORK_DELAYABLE_DEFINE(
    sensor_work,
    sensor_work_handler
);

static void sensor_work_handler(struct k_work *work)
{
    ARG_UNUSED(work);

    int err = sensor_read(&ch1, &ch2);
    if (err) {
        printk("SAADC read failed: %d\n", err);
        k_work_schedule(&sensor_work, K_MSEC(100));
        return;
    }

    printk("SAADC raw: CH1=%u CH2=%u\n",
           (unsigned int)ch1,
           (unsigned int)ch2);

    uint8_t data[4];

    sys_put_le16(ch1, &data[0]);
    sys_put_le16(ch2, &data[2]);

    if (send_enabled && ble_connected) {
        err = bt_gatt_notify(
            NULL,
            &sensor_service.attrs[2],
            data,
            sizeof(data)
        );

        if (err) {
            printk("Notification error: %d\n", err);
        }
    }

    k_work_schedule(&sensor_work, K_MSEC(100));
}

int main(void)
{
    printk("\n");
    printk("================================\n");
    printk("     StretchSense BLE Sensor\n");
    printk("================================\n");

    int err = sensor_io_init();
    if (err) {
        printk("Sensor I/O initialization failed: %d\n", err);
        return 0;
    }

    err = bt_enable(NULL);
    if (err) {
        printk("Bluetooth initialization failed: %d\n", err);
        return 0;
    }

    printk("Bluetooth initialized successfully.\n");

    k_work_schedule(
        &advertising_start_work,
        K_NO_WAIT
    );

    k_work_schedule(
        &sensor_work,
        K_MSEC(100)
    );

    while (1) {
        k_sleep(K_SECONDS(1));
    }

    return 0;
}
```
